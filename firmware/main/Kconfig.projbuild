## firmware/main/Kconfig.projbuild
```kconfig
menu "StandUp sensor"
    config STANDUP_MOCK_SENSOR
        bool "Use simulated distance instead of VL53L1X"
        default y
        help
            Simulate 100 mm and 450 mm in alternating 15-second intervals.
            Packets are explicitly marked as simulated. Disable for real hardware.
    config STANDUP_I2C_SDA
        int "VL53L1X SDA GPIO (verify your board pinout)"
        range 0 20
        default 4
    config STANDUP_I2C_SCL
        int "VL53L1X SCL GPIO (verify your board pinout)"
        range 0 20
        default 5
endmenu
```

## firmware/sdkconfig.defaults
```kconfig
CONFIG_BT_ENABLED=y
CONFIG_BT_NIMBLE_ENABLED=y
CONFIG_BT_NIMBLE_ROLE_CENTRAL=n
CONFIG_BT_NIMBLE_ROLE_OBSERVER=n
CONFIG_BT_NIMBLE_ROLE_PERIPHERAL=y
CONFIG_BT_NIMBLE_ROLE_BROADCASTER=y
CONFIG_BT_NIMBLE_MAX_CONNECTIONS=1
CONFIG_BT_NIMBLE_HOST_TASK_STACK_SIZE=4096
CONFIG_STANDUP_MOCK_SENSOR=y
```
